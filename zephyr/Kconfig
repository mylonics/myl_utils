## zephyr/Kconfig
```kconfig
# Copyright (c) 2024 mylonics.
# SPDX-License-Identifier: Apache-2.0

config MYL_UTILS
	bool "Enable Mylonics Utilities"
	help
	  This option enables the use of the mylonics utilities library.

config MYL_UTILS_CPP
	bool "Enable Mylonics CPP Defaults"
	default n
	select CPP
	select REQUIRES_FULL_LIBCPP
	help
	  This option enables the default mylonics cpp settings.

choice STD_CPP
	depends on MYL_UTILS_CPP
	default STD_CPP17
endchoice

config MYL_UTILS_SERIAL
	bool "Enable Mylonics Uart Utilities"
	default n
	depends on MYL_UTILS
	select SERIAL
	select UART_INTERRUPT_DRIVEN
	select UART_USE_RUNTIME_CONFIGURE
	select UART_DRV_CMD
	select RING_BUFFER
	help
	  This option enables the default mylonics uart settings.

config MYL_UTILS_SPI
	bool "Enable Mylonics SPI Utilities"
	default n
	depends on MYL_UTILS
	select SPI
	help
	  This option enables the use of the mylonics spi libraries.

config MYL_UTILS_I2C
	bool "Enable Mylonics I2C Utilities"
	default n
	depends on MYL_UTILS
	select I2C
	help
	  This option enables the use of the mylonics i2c libraries.

config MYL_UTILS_LORA
	bool "Enable Mylonics Lora Utilities"
	default n
	depends on MYL_UTILS
	select LORA
	help
	  This option enables the use of the mylonics lora libraries.

config MYL_UTILS_LOG
	bool "Enable Mylonics Default Log Configuration"
  default y
	select LOG
	select LOG_BACKEND_RTT
	select CBPRINTF_FP_SUPPORT
	help
	  This option enables myl_utils recommended log configuration

config MYL_UTILS_USB_SERIAL
	bool "Enable Mylonics USB Serial Implementation"
  default n
	depends on MYL_UTILS
	select USB_DEVICE_STACK_NEXT
	select MYL_UTILS_SERIAL
	help
	  This option enables the use of the USB serial implementation.

config MYL_UTILS_LOG_LEVEL
    int "Default log level"
    range 0 4
    default 3
    depends on LOG
    help
      Sets log level for modules which don't specify it explicitly. When
      set to 0 it means log will not be activated for those modules.
      Levels are:

      - 0 OFF, do not write by default
      - 1 ERROR, default to only write LOG_LEVEL_ERR
      - 2 WARNING, default to write LOG_LEVEL_WRN
      - 3 INFO, default to write LOG_LEVEL_INFO
      - 4 DEBUG, default to write LOG_LEVEL_DBG

menu "Myl Utils USB options"
	depends on MYL_UTILS_USB_SERIAL

config MYL_UTILS_USBD_MANUFACTURER
	string "USB device sample manufacturer string"
	default "Mylonics"
	depends on MYL_UTILS_USB_SERIAL
	help
	  USB device sample manufacturer string.

config MYL_UTILS_USBD_PRODUCT
	string "USB device sample product string"
	default "USB Debugger"
	depends on MYL_UTILS_USB_SERIAL
	help
	  USB device sample product stringa.

config MYL_UTILS_USBD_PID
	hex "USB device sample Product ID"
	default 0x0001
	depends on MYL_UTILS_USB_SERIAL
	help
	  USB device sample Product ID.

config MYL_UTILS_USBD_SELF_POWERED
	bool "USB device sample Self-powered attribute"
	default y
	depends on MYL_UTILS_USB_SERIAL
	help
	  Set the Self-powered attribute in the sample configuration.

config MYL_UTILS_USBD_REMOTE_WAKEUP
	bool "USB device sample Remote Wakeup attribute"
	depends on MYL_UTILS_USB_SERIAL
	help
	  Set the Remote Wakeup attribute in the sample configuration.

config MYL_UTILS_USBD_MAX_POWER
	int "USB device sample bMaxPower value"
	depends on MYL_UTILS_USB_SERIAL
	default 125
	range 0 250
	help
	  bMaxPower value in the sample configuration in 2 mA units.

config MYL_UTILS_USBD_20_EXTENSION_DESC
	bool "Use default USB 2.0 Extension Descriptor"
	depends on MYL_UTILS_USB_SERIAL
	help
	  Set bcdUSB value to 0201 and use default USB 2.0 Extension Descriptor.

endmenu
```
